## config/west.yml
```yaml
manifest:
  remotes:
    - name: slicemk
      url-base: https://github.com/slicemk
  projects:
    - name: zmk
      remote: slicemk
      revision: branch-v20251223-rgb
      import: app/west.yml
  self:
    path: config
```
